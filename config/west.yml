## config/west.yml
```yaml
manifest:
  remotes:
    - name: zmkfirmware
      url-base: https://github.com/zmkfirmware
    - name: sayu-hub
      url-base: https://github.com/sayu-hub
    - name: caksoylar  # <-- new entry
      url-base: https://github.com/caksoylar 
    - name: 
      url-base: https://github.com/ark547 # <-- new entry
  projects:
    - name: zmk
      remote: zmkfirmware
      revision: main
      import: app/west.yml
    - name: zmk-pmw3610-driver
      remote: ark547 # <-- change remote sayu-hub
      revision: main
    - name: zmk-rgbled-widget  
      remote: caksoylar
      revision: main
  self:
    path: config
```
